## conf/layer.conf
```bitbake
# We have a conf and classes directory, add to BBPATH
BBPATH .= ":${LAYERDIR}"

# We have recipes-* directories, add to BBFILES
BBFILES += "${LAYERDIR}/recipes-*/*/*.bb \
            ${LAYERDIR}/recipes-*/*/*.bbappend"

BBFILE_COLLECTIONS += "rubygems"
BBFILE_PATTERN_rubygems = "^${LAYERDIR}/"
BBFILE_PRIORITY_rubygems = "6"

LAYERSERIES_COMPAT_rubygems = "sumo"
```
